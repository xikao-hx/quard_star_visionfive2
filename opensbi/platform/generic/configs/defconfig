## opensbi/platform/generic/configs/defconfig
```kconfig
CONFIG_PLATFORM_STARFIVE_JH7110=y
CONFIG_FDT_GPIO=y
CONFIG_FDT_GPIO_STARFIVE=y
CONFIG_FDT_I2C=y
CONFIG_FDT_I2C_DW=y
CONFIG_FDT_IPI=y
CONFIG_FDT_IPI_MSWI=y
CONFIG_FDT_IRQCHIP=y
CONFIG_FDT_IRQCHIP_PLIC=y
CONFIG_FDT_RESET=y
CONFIG_FDT_RESET_GPIO=y
CONFIG_FDT_SERIAL=y
CONFIG_FDT_SERIAL_UART8250=y
CONFIG_FDT_TIMER=y
CONFIG_FDT_TIMER_MTIMER=y
CONFIG_SERIAL_SEMIHOSTING=y
```

## u-boot/board/starfive/visionfive2/Kconfig
```kconfig
if TARGET_STARFIVE_VISIONFIVE2

config SYS_CPU
	default "jh7110"

config SYS_BOARD
	default "visionfive2"

config SYS_VENDOR
	default "starfive"

config SYS_CONFIG_NAME
	default "starfive-visionfive2"

config ENV_SIZE
	default 0x2000 if ENV_IS_IN_SPI_FLASH

config ENV_OFFSET
	default 0x140000 if ENV_IS_IN_SPI_FLASH

config SYS_TEXT_BASE
	default 0x40200000 if SPL
	default 0x40000000 if !RISCV_SMODE
	default 0x40200000 if RISCV_SMODE

config SPL_TEXT_BASE
	default 0x08000000

config SPL_OPENSBI_LOAD_ADDR
	default 0x80000000

config QUARD_BOOTCTRL
	bool "Select VisionFive 2 SD Linux A/B slot from recovery"
	depends on QUARD_NOR_CLIENT && MTD && CMD_PART && CMD_FAT
	help
	  Read current_bank from the recovery MTD partition through the
	  mailbox-backed NOR client and export the matching SD boot/rootfs
	  partition variables.  This helper is built for U-Boot proper only;
	  SPL continues to own recovery updates and payload selection.

config BOARD_SPECIFIC_OPTIONS # dummy
	def_bool y
	select STARFIVE_JH7110
	imply CMD_DHCP
	imply CMD_EXT2
	imply CMD_EXT4
	imply CMD_FAT
	imply CMD_FS_GENERIC
	imply CMD_GPT
	imply PARTITION_TYPE_GUID
	imply CMD_NET
	imply CMD_PING
	imply CMD_SF
	imply DOS_PARTITION
	imply EFI_PARTITION
	imply IP_DYN
	imply ISO_PARTITION
	imply PHY_LIB
	imply PHY_MSCC

endif
```
